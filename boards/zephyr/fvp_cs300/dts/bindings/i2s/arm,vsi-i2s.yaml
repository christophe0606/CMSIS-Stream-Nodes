## boards/zephyr/fvp_cs300/dts/bindings/i2s/arm,vsi-i2s.yaml
```yaml
# Copyright (c) 2026 Arm Limited or its affiliates.
# SPDX-License-Identifier: Apache-2.0

description: Arm Virtual Streaming Interface exposed as an I2S receiver

compatible: "arm,vsi-i2s"

include: i2s-controller.yaml

properties:
  reg:
    required: true

  interrupts:
    required: true

  source-file:
    type: string
    required: true
    description: WAV file passed to the FVP VSI audio model
```

## zephyr_runner/Kconfig
```kconfig
# Copyright (c) 2026 Arm Limited or its affiliates.
# SPDX-License-Identifier: Apache-2.0

config NUM_IRQS
	default 240 if BOARD_MPS3_CORSTONE300_FVP

config ACTIVATION_BUF_SZ
	hex "Tensor arena size"
	default 0x20000

config VSI_LOG_LEVEL
	int "VSI log level"
	default 3

source "Kconfig.zephyr"
```
